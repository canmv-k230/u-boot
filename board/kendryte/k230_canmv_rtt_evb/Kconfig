## board/kendryte/k230_canmv_rtt_evb/Kconfig
```kconfig
if TARGET_K230_CANMV_RTT_EVB

config SYS_CPU
	default "k230"

config SYS_VENDOR
	default "kendryte"

config SYS_BOARD
	default "k230_canmv_rtt_evb"

config SYS_CONFIG_NAME
	default "k230_common"

config BOARD_SPECIFIC_OPTIONS
	def_bool y
	select KENDRYTE_K230

    choice
        prompt "DDR Type And Frequency"
        default CANMV_RTT_EVB_BOARD_LPDDR3_1866

        config CANMV_RTT_EVB_BOARD_LPDDR3_2133
            bool "k230 canmv rtt evb board ddr3 2133"
        config CANMV_RTT_EVB_BOARD_LPDDR3_1866
            bool "k230 canmv rtt evb board ddr3 1866"
    endchoice
endif
```

## drivers/kburn/Kconfig
```kconfig
menu "Kendryte burning support"

config KBURN
    bool
    imply KBURN_OVER_USB if USB_GADGET

config KBURN_OVER_USB
    bool
	depends on USB_GADGET

if KBURN
config KBURN_EMMC
    bool "MMC backend for KBURN"
    select DM
    help
	  This option enables using KBURN to read and write to MMC based storage.

config KBURN_SF
    bool "sf(SPI Flash) backend for KBURN"
    select DM_SPI_FLASH
	help
	  This option enables using KBURN to read and write to SPI flash based
	  storage.

endif
endmenu
```
