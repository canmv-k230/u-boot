## board/kendryte/k230_canmv_hiwonder/Kconfig
```kconfig
if TARGET_K230_CANMV_HIWONDER

	config SYS_CPU
		default "k230"

	config SYS_VENDOR
		default "kendryte"

	config SYS_BOARD
		default "k230_canmv_hiwonder"

	config SYS_CONFIG_NAME
		default "k230_common"

	config BOARD_SPECIFIC_OPTIONS
		def_bool y
		select KENDRYTE_K230

	choice
		prompt "DDR Type And Frequency"
		default CANMV_HIWONDER_LPDDR4_2667

		config CANMV_HIWONDER_LPDDR3_2133
			bool "LPDDR3@2133"
		config CANMV_HIWONDER_LPDDR3_1600
			bool "LPDDR3@1600"
		config CANMV_HIWONDER_LPDDR3_800
			bool "LPDDR3@800"
		config CANMV_HIWONDER_LPDDR4_2667
			bool "LPDDR4@2667"
		config CANMV_HIWONDER_LPDDR4_3200
			bool "LPDDR4@3200"
		config CANMV_HIWONDER_LPDDR4_1066_NODT
			bool "LPDDR4@1066 NODT"
		config CANMV_HIWONDER_LPDDR4_1066
			bool "LPDDR4@1066 "
	endchoice

endif
```

## board/kendryte/k230_canmv_mrt/Kconfig
```kconfig
if TARGET_K230_CANMV_MRT

    config SYS_CPU
        default "k230"

    config SYS_VENDOR
        default "kendryte"

    config SYS_BOARD
        default "k230_canmv_mrt"

    config SYS_CONFIG_NAME
        default "k230_common"

    config BOARD_SPECIFIC_OPTIONS
        def_bool y
        select KENDRYTE_K230

    choice
        prompt "DDR Type And Frequency"
        default CANMV_MRT_LPDDR4_2667

        config CANMV_MRT_LPDDR4_2667
            bool "k230 canmv mrt ddr4 2667"    
    endchoice
endif
```

## board/kendryte/k230_canmv_rockbase/Kconfig
```kconfig
if TARGET_K230_CANMV_ROCKBASE

        config SYS_CPU
                default "k230"

        config SYS_VENDOR
                default "kendryte"

        config SYS_BOARD
                default "k230_canmv_rockbase"

        config SYS_CONFIG_NAME
                default "k230_common"

        config BOARD_SPECIFIC_OPTIONS
                def_bool y
                select KENDRYTE_K230

        choice
                prompt "DDR Type And Frequency"
                default CANMV_ROCKBASE_LPDDR4_2667

                config CANMV_ROCKBASE_LPDDR4_2667
                        bool "LPDDR4@2667"
                config CANMV_ROCKBASE_LPDDR4_1066
                        bool "LPDDR4@1066"
                config CANMV_ROCKBASE_LPDDR4_1066_NODT
                        bool "LPDDR4@1066 WITHOUT ODT"
        endchoice

endif
```

## board/kendryte/k230_canmv_wondermk/Kconfig
```kconfig
if TARGET_K230_CANMV_WONDERMK

	config SYS_CPU
		default "k230"

	config SYS_VENDOR
		default "kendryte"

	config SYS_BOARD
		default "k230_canmv_wondermk"

	config SYS_CONFIG_NAME
		default "k230_common"

	config BOARD_SPECIFIC_OPTIONS
		def_bool y
		select KENDRYTE_K230

	choice
		prompt "DDR Type And Frequency"
		default CANMV_WONDERMK_LPDDR4_2667

		config CANMV_WONDERMK_LPDDR3_2133
			bool "LPDDR3@2133"
		config CANMV_WONDERMK_LPDDR3_1600
			bool "LPDDR3@1600"
		config CANMV_WONDERMK_LPDDR3_800
			bool "LPDDR3@800"
		config CANMV_WONDERMK_LPDDR4_2667
			bool "LPDDR4@2667"
		config CANMV_WONDERMK_LPDDR4_3200
			bool "LPDDR4@3200"
		config CANMV_WONDERMK_LPDDR4_1066_NODT
			bool "LPDDR4@1066 NODT"
		config CANMV_WONDERMK_LPDDR4_1066
			bool "LPDDR4@1066 "
	endchoice

endif
```

## board/kendryte/k230_canmv_yahboom/Kconfig
```kconfig
if TARGET_K230_CANMV_YAHBOOM

	config SYS_CPU
		default "k230"

	config SYS_VENDOR
		default "kendryte"

	config SYS_BOARD
		default "k230_canmv_yahboom"

	config SYS_CONFIG_NAME
		default "k230_common"

	config BOARD_SPECIFIC_OPTIONS
		def_bool y
		select KENDRYTE_K230

	choice
		prompt "DDR Type And Frequency"
		default CANMV_YAHBOOM_LPDDR4_2667


        config CANMV_YAHBOOM_LPDDR4_1066
			bool "LPDDR4@1066"
        config CANMV_YAHBOOM_LPDDR4_1600_WITHOUT_ODT
            bool "LPDDR4@1600 without odt"
		config CANMV_YAHBOOM_LPDDR4_2667
			bool "LPDDR4@2667"
        config CANMV_YAHBOOM_LPDDR4_3200
			bool "LPDDR4@3200"
	endchoice

endif
```

## board/kendryte/k230d_canmv_lushanpi_lite/Kconfig
```kconfig
if TARGET_K230D_CANMV_LUSHANPI_LITE

    config SYS_CPU
        default "k230"

    config SYS_VENDOR
        default "kendryte"

    config SYS_BOARD
        default "k230d_canmv_lushanpi_lite"

    config SYS_CONFIG_NAME
        default "k230_common"

    config BOARD_SPECIFIC_OPTIONS
        def_bool y
        select KENDRYTE_K230

endif
```

## board/kendryte/k230d_labplus_ai_camera_v2/Kconfig
```kconfig
if TARGET_K230D_CANMV_LABPLUS_AI_CAMERA_V2

    config SYS_CPU
        default "k230"

    config SYS_VENDOR
        default "kendryte"

    config SYS_BOARD
        default "k230d_labplus_ai_camera_v2"

    config SYS_CONFIG_NAME
        default "k230_common"

    config BOARD_SPECIFIC_OPTIONS
        def_bool y
        select KENDRYTE_K230

endif
```
